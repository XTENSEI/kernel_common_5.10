## drivers/grayravens/Kconfig
```kconfig
# SPDX-License-Identifier: GPL-2.0-only

menuconfig GRAYRAVENS_PERF
	bool "GrayRavens performance helpers"
	depends on CPU_FREQ
	default y
	help
	  Small frequency and reclaim helpers implemented as freq_qos requests
	  rather than as a cpufreq governor.  The governor keeps its own
	  decision making and merely sees one more QoS client, so no scheduler
	  or thermal hot path is touched and no vendor ABI changes.

	  Each helper can be switched off at runtime from
	  /sys/kernel/grayravens/.

	  If unsure, say Y.

if GRAYRAVENS_PERF

config GRAYRAVENS_BOOT_BOOST
	bool "Boost CPU frequency for a short while after boot"
	default y
	help
	  Raise the frequency floor to the policy maximum shortly after boot,
	  hold it, then release.  Helps the cold start of the launcher and the
	  first app launch after a reboot.

config GRAYRAVENS_TOUCH_BOOST
	bool "Boost CPU frequency on touch input"
	depends on INPUT
	default y
	help
	  Raise the frequency floor while the touchscreen reports a new
	  contact, so the first frame after a tap is not computed at the
	  minimum frequency.  The floor is released by a delayed work item, so
	  a continuous drag keeps it raised without any extra work.

config GRAYRAVENS_RECLAIM_TUNE
	bool "Reclaim tuning (kswapd affinity, swappiness)"
	depends on SWAP
	default y
	help
	  Keep kswapd0 on a prime core so reclaim does not queue behind little
	  core scheduling, and lower vm.swappiness to 30.

config GRAYRAVENS_SCREEN_CLAMP
	bool "Cap CPU frequency while the screen is off"
	depends on DRM && KPROBES
	default y
	help
	  Hook the connector DPMS commit and, while the display is blanked, cap
	  every policy at a fraction of its maximum frequency.  The cap is a
	  freq_qos maximum request, so it can only lower a frequency the
	  governor already picked.  The trigger is edge-driven through the DRM
	  commit path, so nothing polls and nothing runs while the screen state
	  is steady.

	  Runtime switches are in /sys/kernel/grayravens/screen/.

config GRAYRAVENS_SCREEN_PCT
	int "Screen-off ceiling (percent of policy maximum)"
	depends on GRAYRAVENS_SCREEN_CLAMP
	default 30
	range 5 100

config GRAYRAVENS_AUDIO_RT
	bool "Raise the priority of audio threads"
	depends on KPROBES && CPU_IDLE
	default y
	help
	  Watch the scheduler's thread-rename point for the audio mixer threads
	  and lift each one, once, to a fixed SCHED_FIFO priority, plus request a
	  short CPU wake-up latency so the cluster does not stay in a deep idle
	  state between audio periods.  Threads that are already real-time are
	  skipped, so this can never demote a thread the vendor stack boosted.

	  Runtime switches are in /sys/kernel/grayravens/audio/.

config GRAYRAVENS_AUDIO_PRIO
	int "Audio thread SCHED_FIFO priority"
	depends on GRAYRAVENS_AUDIO_RT
	default 2
	range 1 20

config GRAYRAVENS_AUDIO_LATENCY_US
	int "CPU wake-up latency request while enabled (us)"
	depends on GRAYRAVENS_AUDIO_RT
	default 100
	range 0 1000
	help
	  A system-wide PM QoS latency request.  Lower values keep CPUs out of
	  deep idle states, which cuts audio wake-up jitter at a battery cost.
	  Set to 0 to only change thread priorities.

config GRAYRAVENS_BOOST_PCT
	int "Touch boost floor (percent of policy maximum)"
	default 100
	range 10 100
	help
	  How far the touch boost raises the frequency floor, as a percentage
	  of each policy's maximum frequency.  Adjustable at runtime through
	  /sys/kernel/grayravens/boost_pct.

config GRAYRAVENS_BOOT_DELAY_MS
	int "Boot boost delay (ms)"
	default 10000
	help
	  Delay between late init and the start of the boot boost.

config GRAYRAVENS_BOOT_HOLD_MS
	int "Boot boost hold time (ms)"
	default 10000

config GRAYRAVENS_TOUCH_HOLD_MS
	int "Touch boost hold time (ms)"
	default 120
	help
	  How long the touch boost floor stays in place after the last input
	  event.  Each new event pushes it back, so a swipe holds it for its
	  whole duration.

config GRAYRAVENS_IOPRIO
	bool "Foreground I/O priority boost"
	default y
	help
	  Raise the io priority of a process group named from userspace, so a
	  game's reads are served before background work.  BFQ and mq-deadline
	  both honour ioprio in this tree.  The group is put back on its
	  nice-derived best-effort level on release.

config GRAYRAVENS_UCLAMP
	bool "Foreground uclamp floor"
	depends on UCLAMP_TASK
	default y
	help
	  Raise the uclamp_min of a task named from userspace for a short
	  hold window, then drop it.  Same effect as a wake-path boost with
	  no code on the wake path.

endif # GRAYRAVENS_PERF
```

## drivers/oplus/Kconfig
```kconfig
# SPDX-License-Identifier: GPL-2.0-only
menu "OPLUS Features"

config OPLUS_FEATURE
	bool "OPLUS Features"
	default y
	help
	  This option enables core drivers and interfaces required for ColorOS
	  and OPlus system frameworks to operate properly on Linux kernels.
	  Features include memory management, scheduler assist, and hardware
	  probing interfaces.

	  If unsure, say Y.

config OPLUS_NANDSWAP
	bool "OPLUS nandswap support"
	depends on SWAP
	default y
	help
	  This option enables the OPlus nandswap subsystem, allowing dynamic
	  RAM expansion (ColorOS dynamic RAM Expansion). It manages swap device
	  routing, anonymous page eviction, and swapcache dropping.

	  If unsure, say Y.

config OPLUS_HEALTHINFO
	bool "OPLUS healthinfo support"
	default y
	help
	  This option enables the OPlus healthinfo procfs interface located at
	  /proc/oplus_healthinfo. It provides userspace system daemons with
	  memory and system health metrics required by ColorOS services.

	  If unsure, say Y.

config OPLUS_DEVINFO
	bool "OPLUS device info support"
	default y
	help
	  This option enables the OPlus device info interface (/proc/devinfo).
	  It dynamically discovers attached block storage (UFS/eMMC) and system
	  memory (DDR type/capacity) using standard Linux kernel subsystems
	  without any hardcoded device tables.

	  If unsure, say Y.

config OPLUS_SCHED_ASSIST
	bool "OPLUS sched assist support"
	default y
	help
	  This option enables the OPlus scheduler assist interface located at
	  /proc/oplus_scheduler/sched_assist. It provides real-time scene-based
	  CPU frequency QoS boosting and dynamic CFS nice acceleration for
	  user-experience (UX) and critical application threads.

	  If unsure, say Y.

config OPLUS_JANK_INFO
	bool "OPLUS jank info and CLM support"
	depends on OPLUS_HEALTHINFO
	default y
	help
	  This option enables the OPlus CPU jank info interface located at
	  /proc/jank_info/cpu_jank_info. It exposes real-time Core Load
	  Monitoring (CLM), CPU load metrics, and foreground task tracking
	  for ColorOS PerformanceService and FrameBoost telemetries.

	  If unsure, say Y.

config OPLUS_THEIA
	bool "OPLUS Theia stability report support"
	default y
	help
	  This option enables the OPlus Theia and system stability telemetry
	  interfaces (/proc/theiaPwkReport, /proc/pwkMonitorParam,
	  /proc/sau_pwknum, /proc/shutdown_detect, /proc/opbootfrom, and
	  /proc/phoenix) required by vendor stability HAL services.

	  If unsure, say Y.

config OPLUS_AFS_CONFIG
	bool "OPLUS anti-freeze service config support"
	default y
	help
	  This option enables the OPlus application anti-freeze configuration
	  interface located at /proc/oplus_afs_config. It provides dynamic
	  freeze rule persistence and toggle states for ColorOS Athena and
	  SystemUI background optimization services.

	  If unsure, say Y.

endmenu
```
